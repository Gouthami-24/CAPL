VERSION ""

NS_ :

BS_:

BU_: BCM IPC
VAL_TABLE_ Switch_Position 1 "ON" 0 "OFF" ;

BO_ 256 BCMMessage: 1 BCM
 SG_ BCM_Siganl : 0|2@1+ (1,0) [0|3] "" Vector__XXX

VAL_ 256 BCM_Siganl 1 "ON" 0 "OFF" ;
