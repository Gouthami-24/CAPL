VERSION ""

NS_ :

BS_:

BU_: IPC BCM
VAL_TABLE_ Switch_Positon 1 "on" 0 "off" ;

BO_ 257 GWMMessage: 8 BCM

BO_ 256 BCMMessage: 1 BCM
 SG_ BCM_Signal : 0|1@1+ (1,0) [0|1] "" Vector__XXX
