VERSION ""

NS_ :

BS_:

BU_: IPC BCM
VAL_TABLE_ Switch_position 1 "on" 0 "off" ;

BO_ 257 GWMMessage: 1 BCM

BO_ 256 BCMMessage: 1 BCM
 SG_ BCM_Signal : 0|2@1+ (1,0) [0|3] "" Vector__XXX

VAL_ 256 BCM_Signal 1 "on" 0 "off" ;
